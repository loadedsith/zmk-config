## config/west.yml
```yaml
manifest:
  remotes:
    - name: zmkfirmware
      url-base: https://github.com/zmkfirmware
    - name: mctechnology17
      url-base: https://github.com/mctechnology17

    # Additional modules containing boards/shields/custom code can be listed here as well
    # See https://docs.zephyrproject.org/3.2.0/develop/west/manifest.html#projects
  projects:
    - name: zmk
      remote: zmkfirmware
      revision: 4ec69cb7e658590adf6354027aca789b364a70c5
      import: app/west.yml
    - name: zmk-nice-oled
      remote: mctechnology17
      revision: main
  self:
    path: config
```
